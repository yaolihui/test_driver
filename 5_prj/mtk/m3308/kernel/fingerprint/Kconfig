## 5_prj/mtk/m3308/kernel/fingerprint/Kconfig
```kconfig
#
#Fingerprint
#

config FPC_FINGERPRINT
    bool "fpc fingerprint"
	default n

config SILEAD_FP
    bool "silead fingerprint"
	default n

config ICNF_FPSENSOR
    bool "Enable ICNF FPSENSOR"
	default n
	help
	  for finger print drivers.

config OTP_SUPPORT
    bool "OTP SUPPORT"
	default n
```
